## yocto/build/conf/bblayers.conf
```bitbake
# POKY_BBLAYERS_CONF_VERSION is increased each time build/conf/bblayers.conf
# changes incompatibly
POKY_BBLAYERS_CONF_VERSION = "2"

BBPATH = "${TOPDIR}"
BBFILES ?= ""

BBLAYERS ?= " \
  /w/poky/meta \
  /w/poky/meta-poky \
  /w/poky/meta-yocto-bsp \
  /w/meta-arm/meta-arm \
  /w/meta-arm/meta-arm-toolchain \
  /w/meta-xilinx/meta-xilinx-core \
  /w/meta-xilinx/meta-xilinx-standalone \
  /w/meta-xilinx/meta-xilinx-bsp \
  /w/meta-xilinx/meta-microblaze \
  /w/meta-xilinx-tools/ \
  /w/meta-custom \
  "
```

## yocto/build/conf/local.conf
```bitbake
CONF_VERSION = "2"
MACHINE = "zynq-generic"
DISTRO ?= "poky"
hostname:pn-base-files = "zyndra"
PACKAGE_CLASSES = "package_ipk"
USER_CLASSES ?= "buildstats"
PATCHRESOLVE = "noop"
BB_NUMBER_THREADS ?= "${@oe.utils.cpu_count()}"
PARALLEL_MAKE ?= "-j ${@oe.utils.cpu_count()}"
DL_DIR ?= "${TOPDIR}/../downloads"
SSTATE_DIR ?= "${TOPDIR}/../sstate-cache"
EXTRA_IMAGE_FEATURES = "debug-tweaks"
DISTRO_FEATURES:remove = "x11 wayland vulkan opengl qemu"
QB_SYSTEM_NAME = ""
IMAGE_FSTYPES = "tar.gz cpio.gz cpio.gz.u-boot ext4 wic wic.bmap"
WKS_FILE = "xilinx-default-sd.wks"
IMAGE_BOOT_FILES += "boot.bin"
HDF_URI = "file:///w/hardware_description.xsa"
EXTRA_IMAGEDEPENDS += "virtual/boot-bin virtual/bootloader"
ACCEPT_XILINX_EULA = "1"
XILINX_WITH_ESW = "xsct"
LICENSE_FLAGS_ACCEPTED += "xilinx"
MACHINE_FEATURES:append = " fpga-overlay"
IMAGE_INSTALL:append = " dropbear ethtool fpga-bitstream opkg spi-tools ad9361 ad9361-txrx ad936x-axi ad936x-tcp"
include conf/version.conf
```

## yocto/meta-custom/conf/layer.conf
```bitbake
BBPATH .= ":${LAYERDIR}"
BBFILES += "${LAYERDIR}/recipes*/*/*.bb ${LAYERDIR}/recipes*/*/*.bbappend"
BBFILE_COLLECTIONS += "meta-custom"
BBFILE_PATTERN_meta-custom = "^${LAYERDIR}/"
BBFILE_PRIORITY_meta-custom = "10"
LAYERSERIES_COMPAT_meta-custom = "scarthgap"
```
